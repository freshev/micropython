## ports/air724/Kconfig
```kconfig
config FW_VERSION
    string "Firmware version"
    default "v1.0"
    help 
    	Firmware version

config MAIN_STUB_URL
    string "URL to get main.py from"
    default ""
    help 
    	URL to get main.py from    	

config ZIP_COMPRESS
    bool "Get main.py from URL in compressed form"
    default y
    help 
    	Get main.py from URL in compressed form


choice HW_UART_REPL
    prompt "REPL port"
    default HW_REPL_USB

	config HW_REPL_USB
	    bool "REPL over USB"
	config HW_REPL_UART_1
	    bool "REPL over UART1"
	config HW_REPL_UART_2
	    bool "REPL over UART2"
endchoice

config MAIN_STUB_RESPAWN 
	bool "Respawned on delete main.py"
	default y
	help
		Respawned on delete main.py

config MAIN_STUB_AUTORUN
	bool "Auto run main.py on load"
	default y
	help
		Auto run main.py on load

config DHT_MODULE
    bool "Include DHT module"
    default y
    help
        If this option is enabled, DHT module is included into the board modules.

config CC1101_MODULE
    bool "Include C1101 module"
    default y
    help
        If this option is enabled, CC1101 module is included into the board modules.

config SMSRESET
	bool "Reset on SMS 'reset'"
	default y
	help
	    Reset module on incoming SMS 'reset'

config SMSRESETACK
	bool "Send acknowledge SMS 'Done' on reset"
	default y
	help
		Send acknowledge SMS 'Done' on reset

config SMSCONFIG
	bool "Set module configiration by SMS" 
	default y
	help
		Set module configiration by SMS

menu "Deploy"
	config DEPLOY_LOD_FOLDER
	    string "Deploy LOD to folder"
        default ""
		help
        	Deploy LOD file to folder
    config DEPLOY_LOD_COMPRESS
		bool "Deploy LOD in compressed form"
		default y
        help
			Deploy LOD file in compressed form
	config DEPLOY_FOTA_FOLDER
	    string "Deploy FOTA pack to folder"
        default ""
		help
        	Deploy FOTA pack to folder
    config DEPLOY_FOTA_COMPRESS
		bool "Deploy FOTA pack in compressed form"
		default n
        help
			Deploy FOTA pack file in compressed form
endmenu

menu "FOTA"
	config FOTA_USE
		bool "Use FOTA routines"
		default y
		help
        	Use FOTA routines
    config FOTA_URL
        string "FOTA URL"
        default "https://example.com/micropython_Air724U_OLDVERSION_to_NEWVERSION.pack"
        help
			URL for FOTA

	config FOTA_REMOVE_PY
	    bool "Remove python files on upgrade"
	    default y
		help
        	Remove python files on upgrade
endmenu
```

## ports/esp32/components/esp32-camera-pins/Kconfig
```kconfig
choice
	prompt "ESP32 Camera Board"
	default BOARD_ESP32CAM_AITHINKER

	config BOARD_WROVER_KIT
		bool "ESP32-Wrover CAM Board"
	config BOARD_ESP32CAM_AITHINKER
		bool "ESP32CAM AI-Thinker board"
	config BOARD_ESP32S3_WROOM
		bool "ESP32-S3 WROOM Board"
	config BOARD_ESP32S3_GOOUUU
		bool "GOOUUU ESP32 S3 CAM Board"
	config BOARD_ESP32CAM_TTGO
		bool "TTGO T-Journal Board"
	config BOARD_ESP32CAM_TTGO_PLUS
		bool "TTGO T-Camera Plus Board"
	config BOARD_ESP32CAM_TTGO_PIR
		bool "TTGO T-Camera with PIR Sensor Board"
	config BOARD_M5_MODEL_A
		bool "M5-Camera Model A"
	config BOARD_M5_MODEL_B
		bool "M5-Camera Model B"
	config BOARD_M5_STACK
		bool "M5-Stack ESP32-Camera"
	config BOARD__ESP_EYE
		bool "ESP-EYE"
endchoice
```

## ports/esp32/components/esp32-deploy/Kconfig
```kconfig
menu "Deploy"
	config DEPLOY_FW_FOLDER
		string "Deploy firmware to folder"
        default ""
	help
        	Deploy LOD file to folder

        config DEPLOY_FW_COMPRESS
		bool "Deploy firmware in compressed form"
		default y
        help
		Deploy LOD file in compressed form
endmenu
```

## ports/esp32/main_esp32/Kconfig.projbuild
```kconfig
menu "Micropython Configuration"
    config MAIN_STUB
        bool "Boot module with (respawned on delete) main.py"
        default y
        help
            If this option is enabled, module will restore absent main.py script.

    config DHT_MODULE
        bool "Include DHT module"
        default y
        help
            If this option is enabled, 'dht' module is included int the board modules.

    config CC1101_MODULE
        bool "Include C1101 module"
        default y
        help
            If this option is enabled, 'cc1101' module is included int the board modules.

    config CAMERA_MODULE
        bool "Include CAMERA module"
        default y
        help
            If this option is enabled, 'camera' module is included int the board modules.

endmenu
```

## ports/esp32/main_esp32s3/Kconfig.projbuild
```kconfig
menu "Micropython Configuration"
    config MAIN_STUB
        bool "Boot module with (respawned on delete) main.py"
        default n
        help
            If this option is enabled, module will restore absent main.py script.

    config DHT_MODULE
        bool "Include DHT module"
        default y
        help
            If this option is enabled, DHT module is included int the board modules.

    config CC1101_MODULE
        bool "Include C1101 module"
        default y
        help
            If this option is enabled, CC1101 module is included int the board modules.
endmenu
```
